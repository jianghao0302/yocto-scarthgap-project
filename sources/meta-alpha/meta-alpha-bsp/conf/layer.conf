## sources/meta-alpha/meta-alpha-bsp/conf/layer.conf
```bitbake
BBPATH .= ":${LAYERDIR}"
BBFILES += "${LAYERDIR}/recipes-*/*/*.bb ${LAYERDIR}/recipes-*/*/*.bbappend"

BBFILE_COLLECTIONS += "alpha-bsp"
BBFILE_PATTERN_alpha-bsp = "^${LAYERDIR}/"
BBFILE_PRIORITY_alpha-bsp = "99"

LAYERDEPENDS_alpha-bsp = "core"
LAYERSERIES_COMPAT_alpha-bsp = "scarthgap"
```

## sources/meta-alpha/meta-alpha-bsp/conf/machine/alpha-imx6ull14x14evk.conf
```bitbake
require conf/machine/include/alpha-common.inc
require conf/machine/imx6ull14x14evk.conf

MACHINEOVERRIDES =. "alpha-imx6ull14x14evk:"
ALPHA_VENDOR = "nxp"
ALPHA_PRODUCT_FAMILY = "imx6ull"

# Add board-specific kernel, u-boot and DT settings in bbappends under
# meta-alpha-bsp instead of editing vendor layers directly.
```

## sources/meta-alpha/meta-alpha-bsp/conf/machine/imx6ull14x14alpha.conf
```bitbake
require conf/machine/include/alpha-imx-base.inc

MACHINEOVERRIDES =. "imx6ull14x14alpha:mx6ull:"
ALPHA_VENDOR = "alpha"
ALPHA_PRODUCT_FAMILY = "imx6ull"

DEFAULTTUNE = "cortexa7thf-neon"

UBOOT_CONFIG ??= "sd"
UBOOT_CONFIG[sd] = "mx6ull_14x14_alpha_mmc_defconfig,sdcard"
UBOOT_DTB_NAME = "imx6ull-14x14-alpha-mmc.dtb"
UBOOT_ENTRYPOINT = "0x80008000"
UBOOT_MAKE_TARGET = "u-boot.imx"
UBOOT_BINARY = "u-boot.imx"
UBOOT_SUFFIX = "imx"

KERNEL_IMAGETYPE = "zImage"
KERNEL_DEVICETREE = "nxp/imx/imx6ull-14x14-alpha-mmc.dtb"
KBUILD_DEFCONFIG = "imx6ull_14x14_alpha_mmc_defconfig"

# SD card image (WIC + sdcard symlink)
WKS_FILE = "alpha-uboot-bootpart.wks.in"
WKS_FILE_DEPENDS += " virtual/bootloader"
# Append wic/wic.bmap to the base IMAGE_FSTYPES (which already has ext4, tar.gz from distro)
IMAGE_FSTYPES:append = " wic wic.bmap"
INHERIT += "image_types_alpha"
IMAGE_BOOT_FILES ?= "${KERNEL_IMAGETYPE} imx6ull-14x14-alpha-mmc.dtb"


MACHINE_FEATURES += "usbhost usbgadget ext2 vfat"
```

## sources/meta-alpha/meta-alpha-bsp/conf/machine/include/alpha-common.inc
```bitbake
# Common ALPHA machine settings live here.
# Individual board machine files should require this include and then require
# the relevant vendor machine to inherit the SoC BSP defaults.

MACHINEOVERRIDES =. "alpha:"
ALPHA_VENDOR ?= "generic"
ALPHA_PRODUCT_FAMILY ?= "generic"
```

## sources/meta-alpha/meta-alpha-bsp/conf/machine/include/alpha-imx-base.inc
```bitbake
# Common ALPHA machine settings live here.
# Individual board machine files should require this include and then require
# the relevant vendor machine to inherit the SoC BSP defaults.

include conf/machine/include/arm/armv7a/tune-cortexa7.inc

MACHINEOVERRIDES =. "alpha:"
ALPHA_VENDOR ?= "generic"
ALPHA_PRODUCT_FAMILY ?= "generic"

PREFERRED_PROVIDER_u-boot = "u-boot-imx"
PREFERRED_PROVIDER_u-boot-mfgtool = "u-boot-imx"
PREFERRED_PROVIDER_virtual/bootloader = "u-boot-imx"
PREFERRED_VERSION_u-boot-imx = "2025.04%"

PREFERRED_PROVIDER_virtual/kernel = "linux-imx"
PREFERRED_VERSION_linux-imx = "6.12%"

SERIAL_CONSOLES = "115200;ttymxc0"

SOC_DEFAULT_WKS_FILE                 ?= "imx-uboot-bootpart.wks.in"
```

## sources/meta-alpha/meta-alpha-product/conf/distro/alpha-imx6ull-mmc.conf
```bitbake
require conf/distro/alpha.conf

DISTRO = "alpha-imx6ull-mmc"
DISTRO_NAME = "ALPHA i.MX6ULL MMC Distro"
DISTROOVERRIDES .= ":alpha-imx6ull-mmc:mx6ull:mmc"

# i.MX6ULL + MMC specific version preferences
PREFERRED_VERSION_linux-imx ?= "6.12%"
PREFERRED_VERSION_u-boot-imx ?= "2025.04%"
```

## sources/meta-alpha/meta-alpha-product/conf/distro/alpha.conf
```bitbake
DISTRO = "alpha"
DISTRO_NAME = "ALPHA Embedded Linux"
DISTRO_VERSION = "1.0"
DISTRO_CODENAME = "scarthgap-based"

# Vendor identifiers
# NOTE: Do NOT use "-alpha" here - glibc configure interprets "alpha" in the
# vendor field as DEC Alpha CPU architecture and injects Alpha-specific flags
# (-mieee, -mfp-rounding-mode=d) which are invalid for ARM cross-compiler.
TARGET_VENDOR = "-alphadistro"
SDK_VENDOR = "-alphasdk"

# Use systemd as default init manager (more modern than sysvinit)
INIT_MANAGER = "systemd"

# Default distro features for generic embedded products
# ipv4 ipv6: Network stack
# systemd: Init system
# pam: Pluggable authentication modules
# selinux: Security (optional for embedded)
DISTRO_FEATURES_DEFAULT = "ipv4 ipv6 systemd pam"
ALPHA_DEFAULT_DISTRO_FEATURES = ""
DISTRO_FEATURES ?= "${DISTRO_FEATURES_DEFAULT} ${ALPHA_DEFAULT_DISTRO_FEATURES}"

# Package management format (DEB for smaller footprint, RPM for enterprise)
PACKAGE_CLASSES ?= "package_deb"

# Image formats: rootfs archives + filesystem images
# ext4: Raw ext4 filesystem (for flashing or further processing)
# tar.gz: Compressed rootfs tarball
# tar.bz2: tar with bzip2 compression
# cpio.gz: Initramfs-style compressed archive
IMAGE_FSTYPES ?= "ext4 tar.gz"

# SDK configuration
SDK_NAME = "${DISTRO}-${TCLIBC}-${SDKMACHINE}-${IMAGE_BASENAME}-${TUNE_PKGARCH}-${MACHINE}"
SDKPATHINSTALL = "/opt/${DISTRO}/${DISTRO_VERSION}"

# Standard toolchain libraries
TCLIBCAPPEND = ""

# Extra packages/features inherited by all images using this distro
DISTRO_EXTRA_RDEPENDS ?= ""
DISTRO_EXTRA_RRECOMMENDS ?= ""

# Security and quality assurance settings
INHERIT += "sanity"

# Signature handling for build reproducibility
BB_SIGNATURE_HANDLER ?= "OEEquivHash"
BB_HASHSERVE ??= "auto"

# SPDX/licensing support
INHERIT += "spdx-common"

# Disable static libraries by default (reduces image size)
STATIC_LIBRARIES = "ncurses gnutls"
DISABLE_STATIC = "1"

# License manifests for compliance
INHERIT += "license"
```

## sources/meta-alpha/meta-alpha-product/conf/distro/include/alpha-base.inc
```bitbake
require conf/distro/poky.conf

DISTRO = "alpha"
DISTRO_NAME = "Alpha Release Distro"
DISTRO_VERSION = "1.0"
DISTROOVERRIDES = "alpha"

MAINTAINER = "ALPHA <lauren.post@alpha.com>"

# Use systemd as default init manager
POKY_INIT_MANAGER = "systemd"0
```

## sources/meta-alpha/meta-alpha-product/conf/layer.conf
```bitbake
BBPATH .= ":${LAYERDIR}"
BBFILES += "${LAYERDIR}/recipes-*/*/*.bb ${LAYERDIR}/recipes-*/*/*.bbappend"

BBFILE_COLLECTIONS += "alpha-product"
BBFILE_PATTERN_alpha-product = "^${LAYERDIR}/"
BBFILE_PRIORITY_alpha-product = "100"

LAYERDEPENDS_alpha-product = "core alpha-bsp"
LAYERSERIES_COMPAT_alpha-product = "scarthgap"
```
